
/dts-v1/;

/include/ "vexpress-a9.dtsi"

/ {
	chosen {
		console = &SERIAL0;
		rtcdev = &RTC0;
		bootcmd = /* Create rbd0 device */
			  "rbd create rbd0 0x61000000 0x01000000",

			  /* Mount rbd0 device */
			  "vfs mount rbd0 /",


			  /* Copy guest0 device tree from templates */
			  "devtree node copy /guests guest0 /templates/vexpress-a9x2",

			  /* Copy guest1 device tree from templates */
			  "devtree node copy /guests guest1 /templates/vexpress-a9x2",


			  /* Update guest0 memory regions */
			  "devtree attr set /guests/guest0/aspace/mem0 physical_size physsize 0x04000000",
			  "devtree attr set /guests/guest0/aspace/mem1 host_physical_addr physaddr 0x62000000",
			  "devtree attr set /guests/guest0/aspace/mem1 physical_size physsize 0x06000000",

			  /* Update guest1 memory regions */
			  "devtree attr set /guests/guest1/aspace/mem0 physical_size physsize 0x04000000",
			  "devtree attr set /guests/guest1/aspace/mem1 host_physical_addr physaddr 0x68000000",
			  "devtree attr set /guests/guest1/aspace/mem1 physical_size physsize 0x06000000",


			  /* Update guest0 videoram regions */
			  "devtree attr set /guests/guest0/aspace/videoram host_physical_addr physaddr 0x6E000000",
			  "devtree attr set /guests/guest0/aspace/videoram physical_size physsize 0x00400000",

			  /* Update guest1 videoram regions */
			  "devtree attr set /guests/guest1/aspace/videoram host_physical_addr physaddr 0x6E800000",
			  "devtree attr set /guests/guest1/aspace/videoram physical_size physsize 0x00400000",


			  /* Update guest0 flash region */
			  "devtree attr set /guests/guest0/aspace/nor_flash0 host_physical_addr physaddr 0x6F000000",
			  "devtree attr set /guests/guest0/aspace/nor_flash0 physical_size physsize 0x00100000",

			  /* Update guest1 flash region */
			  "devtree attr set /guests/guest1/aspace/nor_flash0 host_physical_addr physaddr 0x6F100000",
			  "devtree attr set /guests/guest1/aspace/nor_flash0 physical_size physsize 0x00100000",


			  /* Update guest0 sram regions */
			  "devtree attr set /guests/guest0/aspace/sram host_physical_addr physaddr 0x6F200000",
			  "devtree attr set /guests/guest0/aspace/sram physical_size physsize 0x00400000",

			  /* Update guest1 sram regions */
			  "devtree attr set /guests/guest1/aspace/sram host_physical_addr physaddr 0x6F600000",
			  "devtree attr set /guests/guest1/aspace/sram physical_size physsize 0x00600000",


			  /* Update guest0 shared memory region (writing part) */
			  "devtree attr set /guests/guest0/aspace/sharedw host_physical_addr physaddr 0x6FC00000",
			  "devtree attr set /guests/guest0/aspace/sharedw physical_size physsize 0x00200000",

			  "devtree attr set /guests/guest0/aspace/sharedr alias_physical_addr physaddr 0x6FE00000",
			  "devtree attr set /guests/guest0/aspace/sharedr physical_size physsize 0x00200000",

			  /* Update guest1 shared memory region (writing part) */
			  "devtree attr set /guests/guest1/aspace/sharedw host_physical_addr physaddr 0x6FE00000",
			  "devtree attr set /guests/guest1/aspace/sharedw physical_size physsize 0x00200000",

			  "devtree attr set /guests/guest1/aspace/sharedr alias_physical_addr physaddr 0x6FC00000",
			  "devtree attr set /guests/guest1/aspace/sharedr physical_size physsize 0x00200000",


			  /* Connect guest0/virtio-net0 netport to br0 */
			  "devtree attr set /guests/guest0/aspace/virtio-net0 switch string br0",

			  /* Connect guest0/lan9118 netport to br0 */
			  "devtree attr set /guests/guest0/aspace/lan9118 switch string br0",

			  /* Connect guest1/virtio-net0 netport to br0 */
			  "devtree attr set /guests/guest1/aspace/virtio-net0 switch string br0",

			  /* Connect guest1/lan9118 netport to br0 */
			  "devtree attr set /guests/guest1/aspace/lan9118 switch string br0",


			  /* Create guest0 */
			  "guest create guest0",

			  /* Create guest1 */
			  "guest create guest1",



			  /* /\* Load guest images *\/ */
			  "vfs guest_load_list guest0 /images/arm32/vexpress-a9/nor_flash.list",
			  "vfs guest_load_list guest1 /images/arm32/vexpress-a9/nor_flash.list";
	};
};
